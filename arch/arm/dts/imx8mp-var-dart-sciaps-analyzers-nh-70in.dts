// SPDX-License-Identifier: (GPL-2.0+ OR MIT)
/*
 * Copyright 2026 SciAps
 */

#include "imx8mp-var-dart-sciaps-analyzers-nh-70in.dtsi"

/ {
	model = "SciAps Analyzers based on Variscite DART-MX8M-PLUS SOM 2.0 and above - v0.1 - NH 7.0in Display";
};
