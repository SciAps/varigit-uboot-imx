// SPDX-License-Identifier: (GPL-2.0+ OR MIT)
/*
 * Copyright 2025 SciAps
 */

#define DART_REV_1X
#include "imx8mp-var-dart-sciaps-analyzers-otd-27in-citrobits.dtsi"

/ {
	model = "SciAps Analyzers based on Variscite DART-MX8M-PLUS SOM 1.x - v0.1 - OTD(Citrobits) 2.7in Display";
};
